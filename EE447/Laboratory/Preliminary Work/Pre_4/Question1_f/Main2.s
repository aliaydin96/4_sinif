FIRST	   		EQU	0x20000480

; Timer 0,A
TIMER2_CFG	EQU	0x40032000;
TIMER2_TAMR	EQU	0x40032004;
TIMER2_CTL	EQU	0x4003200C;
TIMER2_IMR	EQU	0x40032018;
TIMER2_TAILR	EQU	0x40032028;
TIMER2_TAPR	EQU	0x40032038;
TIMER2_TAR	EQU	0x40032048;
TIMER2_TAV	EQU	0x40032050;
TIMER2_RIS	EQU	0x4003201C;
TIMER2_ICR	EQU	0x40032024;
SYSCTL_RCGCTIMER 	EQU 0x400FE604 ; GPTM Gate Control
GPIO_DATA_F	EQU		0x40025004; PF0

;LABEL		DIRECTIVE	VALUE		COMMENT
			AREA    	main, READONLY, CODE
			THUMB
			EXTERN		PULSE_INIT		; Pulse initialization	
			EXPORT  	__main	; Make available

__main
			BL	PULSE_INIT;	
;Start timer clock
			LDR	R1,=SYSCTL_RCGCTIMER;
			LDR	R2,[R1];
			ORR	R2,R2,#0x04;
			STR	R2,[R1];
;Disable Timer
			LDR	R1,=TIMER2_CTL;
			LDR	R2,[R1];
			BIC	R2,#0x01;
			STR	R2,[R1];
;CFG
			LDR	R1,=TIMER2_CFG;
			LDR	R2,[R1];
			ORR	R2,#0x04;
			STR	R2,[R1];
;TAMR			
			LDR	R1,=TIMER2_TAMR;
			LDR	R2,[R1];
			ORR	R2,#0x204; Edge Time Mode & Count Up
			STR	R2,[R1];
;ILR
			LDR	R1,=TIMER2_TAILR;
			MOV	R0,#0xFFFF;
			STR	R0,[R1];
;CTL		
			LDR	R1,=TIMER2_CTL;
			LDR	R2,[R1];
			ORR	R2,#0x0F;
			STR	R2,[R1];
;Initialization Completed
			LDR	R1,=TIMER2_RIS;
find		LDR	R2,[R1];
			AND	R0,R2,#0x01;
			CMP	R0,#0
			BEQ	find;
; if an edge is captured
			LDR	R1,=TIMER2_ICR;
			LDR	R2,[R1];
			BIC	R2,#0x04;
			STR	R2,[R1];
			;Interrupt is cleaned
			LDR	R1,=TIMER2_TAR;
			LDR	R2,=FIRST;
			LDR	R0,[R1];
			STR	R0,[R2];
			LDR	R1,=TIMER2_TAV;
			LDR	R2,[R1];
			AND	R2,#0;
			STR	R2,[R1];
			B	find;
			

			


			ALIGN
			END